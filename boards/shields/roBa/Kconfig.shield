## boards/shields/roBa/Kconfig.shield
```kconfig
config SHIELD_ROBA
    bool "roBa shield"
    help
      Parent config for roBa keyboard shields.

config SHIELD_ROBA_R
    bool "roBa Right"
    select SHIELD_ROBA
    default y if SHIELD_LIST_CONTAINS_roBa_R

config SHIELD_ROBA_L
    bool "roBa Left"
    select SHIELD_ROBA
    default y if SHIELD_LIST_CONTAINS_roBa_L
```

## boards/shields/roba/Kconfig.shield
```kconfig
config SHIELD_roba
    bool "roba shield"
    help
      Parent config for roba keyboard shields.

config SHIELD_roba_r
    bool "roba Right"
    select SHIELD_roba
    default y if SHIELD_LIST_CONTAINS_roba_r

config SHIELD_roba_l
    bool "roba Left"
    select SHIELD_roba
    default y if SHIELD_LIST_CONTAINS_roba_l
```

## boards/shields/roba_l/Kconfig.defconfig
```kconfig
if SHIELD_roba_l

config ZMK_KEYBOARD_NAME
    default "roba_l"

config ZMK_SPLIT
    default y

endif
```

## boards/shields/roba_r/Kconfig.defconfig
```kconfig
if SHIELD_roba_r

config ZMK_KEYBOARD_NAME
    default "roba_r"

config ZMK_SPLIT
    default y

config ZMK_SPLIT_ROLE_CENTRAL
    default y

endif
```

## config/west.yml
```yaml
manifest:
  remotes:
    - name: zmk
      url-base: https://github.com/zmkfirmware
  projects:
    - name: zmk
      remote: zmk
      revision: refs/tags/v0.1.0
  self:
    path: config
```
